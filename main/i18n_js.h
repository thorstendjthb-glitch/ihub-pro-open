// i18n_js.h — served at /i18n.js, included by the dashboard and settings pages.
// German is the SOURCE language of the UI. When the user picks English in Settings
// (stored in localStorage 'ihub_lang'='en'), this script translates the live DOM via
// the dictionary below — including dynamically inserted content (MutationObserver).
// A bad/missing translation just leaves that string in German; it never breaks the app.
#pragma once

static const char I18N_JS[] = R"JS(
(function(){
  var lang;
  try { lang = localStorage.getItem('ihub_lang') || 'de'; } catch(e) { return; }
  if (lang !== 'en') return;
  var EN = {
  "⚙ Einstellungen": "⚙ Settings",
  "Einstellungen": "Settings",
  "Grow-Profile — Sollwerte je Profil": "Grow profiles — setpoints per profile",
  "Profil": "Profile",
  "Licht h": "Light h",
  "Licht an": "Light on",
  "Rampe min": "Ramp min",
  "VPD ±": "VPD ±",
  "T Tag": "T Day",
  "T Nacht": "T Night",
  "T ±": "T ±",
  "rH Tag": "rH Day",
  "rH Nacht": "rH Night",
  "CO₂ Tag": "CO₂ Day",
  "Licht %": "Light %",
  "DLI-Ziel": "DLI target",
  "PPFD-Regel.": "PPFD ctrl.",
  "PPFD-Ziel": "PPFD target",
  "Rampe = Sonnenauf-/untergang-Dauer (0 = aus). „Automatics\" fährt durchgehend (20/4). DLI-Ziel in mol/m²/Tag (0 = aus; braucht PAR-Sensor — bei Erreichen wird das Licht auf die DLI-Drossel gedimmt, die Photoperiode bleibt). Alarm-Spalten: T-Max/T-Min in °C, rH-Max in %, CO₂-Max in ppm — jeweils 0 = Alarm aus.": "Ramp = sunrise/sunset duration (0 = off). 'Autoflower' runs continuously (20/4). DLI target in mol/m²/day (0 = off; requires PAR sensor — on reaching the target, light dims to the DLI floor, photoperiod continues). Alarm columns: T-Max/T-Min in °C, rH-Max in %, CO₂-Max in ppm — 0 = alarm off.",
  "Alarme & Sicherheit — global": "Alarms & security — global",
  "Buzzer aktiv": "Buzzer enabled",
  "akustischer Alarm an/aus": "audible alarm on/off",
  "Alarm-Wiederholung": "Alarm repeat",
  "Sekunden zwischen Buzzer-Tönen bei Daueralarm": "seconds between buzzer tones during continuous alarm",
  "Lüfter Mindestlaufzeit": "Fan minimum run time",
  "Sekunden — Anti-Takt-Sperre Abluft": "seconds — exhaust anti-short-cycle lock",
  "Übertemp → Lampen drosseln": "Overtemp → dim lights",
  "bei Übertemp-Alarm auf 50%": "on overtemp alarm, dim to 50%",
  "Übertemp → Abluft erzwingen": "Overtemp → force exhaust",
  "Sensor-Ausfall-Alarm": "Sensor failure alarm",
  "Alarm wenn Klimasensor nicht antwortet": "alarm when climate sensor does not respond",
  "Abluft Grundlast %": "Exhaust base load %",
  "RS-485-Inline-Fan Dauerzug (Geruch/Aktivkohle)": "RS-485 inline fan continuous draw (odor/carbon filter)",
  "Abluft Maximal %": "Exhaust maximum %",
  "Drehzahl bei Hitze/Schimmel": "speed at heat/mold",
  "Klimaanlage-Verzögerung min": "AC delay min",
  "Abluft läuft so lange erfolglos gegen Kühl-/Trocknungsbedarf (Außenluft zu warm/feucht) → erst dann AC anfordern. 0 = sofort": "Exhaust runs this long without meeting cooling/drying demand (outside air too warm/humid) → only then request AC. 0 = immediately",
  "CO₂-Frischluft-Baseline ppm": "CO₂ fresh-air baseline ppm",
  "CO₂ = Sensor-Messanteil + Baseline. Frischluft-Kalibrierung: bei frischer Außenluft soll der Wert ~420 zeigen. Default 420": "CO₂ = sensor reading + baseline. Fresh-air calibration: in fresh outdoor air the value should read ~420. Default 420",
  "Klimaanlage in Kammer": "AC in chamber",
  "Nur diese Kammer fordert die Klima an und drosselt bei AC-Betrieb ihre Abluft": "Only this chamber requests the AC and throttles its exhaust during AC operation",
  "PAR-/PPFD-Sensor in Kammer": "PAR/PPFD sensor in chamber",
  "Nur dort greifen PPFD-Lichtregelung + DLI-Drossel; die andere Kammer nutzt feste %-Helligkeit": "Only this chamber uses PPFD light control + DLI floor; the other chamber uses fixed % brightness",
  "keine AC": "no AC",
  "Beleuchtung — 0-10V Polarität": "Lighting — 0–10 V polarity",
  "Licht 1 invertiert": "Light 1 inverted",
  "an = 0V hell / 10V aus": "on = 0 V bright / 10 V off",
  "Licht 2 invertiert": "Light 2 inverted",
  "DLI-Drossel %": "DLI floor %",
  "Helligkeit nach Erreichen des DLI-Ziels (Spalte „DLI-Ziel\" oben); Photoperiode läuft weiter": "Brightness after reaching the DLI target (column 'DLI target' above); photoperiod continues",
  "Lampen-Ausfall-Lux": "Lamp failure lux",
  "Mindest-Lux am TH3in1-Lichtsensor, wenn Licht laut Plan AN sein soll — sonst Lampen-Ausfall-Alarm. 0 = aus": "Minimum lux at TH3in1 light sensor when the light should be ON per schedule — otherwise lamp failure alarm. 0 = off",
  "Kammern — Profil & Klimasensor je Kammer": "Chambers — profile & climate sensor per chamber",
  "Kammer": "Chamber",
  "Klimasensor": "Climate sensor",
  "BLE-Gerät (nur bei BLE)": "BLE device (BLE only)",
  "Sensor-Quelle:": "Sensor source:",
  "Jede Kammer regelt eigenständig.": "Each chamber controls independently.",
  "Grow-Plan — zeitgesteuerte Phasenabfolge": "Grow plan — timed phase sequence",
  "Ist der Plan aktiv und ein Grow-Start gesetzt, wechselt das Profil automatisch nach den Tagen (manuelle Profilwahl pausiert). Nach Plan-Ende bleibt die letzte Phase. Tipp: 1 Woche = 7 Tage. Klima/VPD wird je Profil geregelt.": "If the plan is active and a grow start is set, the profile switches automatically after the specified days (manual profile selection is paused). After the plan ends, the last phase remains. Tip: 1 week = 7 days. Climate/VPD is controlled per profile.",
  "Dachboden / Quellluft — Free-Cooling-Referenz": "Attic / source air — free-cooling reference",
  "Sensor-Quelle": "Sensor source",
  "BLE-Gerät (bei BLE)": "BLE device (BLE)",
  "Vergleicht die Quellluft mit der Kammer: ist sie kühler bzw. (absolut) trockener → es wird gelüftet, sonst Klimaanlage angefordert. Quelle z.B. ein BLE-TP357 am Dachboden statt des Fan-Bus-Sensors.": "Compares source air with the chamber: if it is cooler or (absolutely) drier → ventilation is used, otherwise AC is requested. Source can be e.g. a BLE TP357 in the attic instead of the fan-bus sensor.",
  "Geräte-Zuordnung — Steckdose → Kammer & Rolle": "Device assignment — outlet → chamber & role",
  "Steckdose": "Outlet",
  "Rolle": "Role",
  "Dimmer 1 (Licht)": "Dimmer 1 (light)",
  "Dimmer 2 (Licht)": "Dimmer 2 (light)",
  "Abluft stufenlos (RS-485)": "Exhaust variable (RS-485)",
  "Jede Steckdose gehört einer Kammer (A/B) und hat eine Rolle (Licht, Heizung, …). Die Regelung schaltet je Kammer nur ihre eigenen Geräte. „—\" = keiner Kammer zugeordnet (nur manuell/MQTT). Der stufenlose Abluft-iFan + MarsHydro-Luftbefeuchter gehören genau der hier gewählten Kammer.": "Each outlet belongs to a chamber (A/B) and has a role (light, heater, …). The controller only switches its own devices per chamber. '—' = not assigned to a chamber (manual/MQTT only). The variable exhaust iFan + MarsHydro humidifier belong to the chamber selected here.",
  "Wasserwerte-Alarme (RDWC) — Werte kommen vom Tester über Home Assistant": "Water value alarms (RDWC) — values come from the tester via Home Assistant",
  "Alarme aktiv": "Alarms enabled",
  "Warnung (Buzzer/Dashboard/HA) bei pH/Wassertemp/ORP außerhalb des Korridors. Default AUS — erst einschalten, wenn echte Nährlösung läuft (sonst Fehlalarm bei Testwasser).": "Warning (buzzer/dashboard/HA) when pH/water temp/ORP is outside the range. Default OFF — only enable when actual nutrient solution is running (otherwise false alarms with test water).",
  "pH min / max": "pH min / max",
  "RDWC-Ziel 5,8–6,2 · 0 = diese Grenze aus": "RDWC target 5.8–6.2 · 0 = this limit off",
  "Wassertemp max / min": "Water temp max / min",
  "°C · Ziel 18–20 · 0 = diese Grenze aus": "°C · target 18–20 · 0 = this limit off",
  "ORP min": "ORP min",
  "mV · < Wert = anaerob/Pathogen-Risiko (RDWC-Routine 350–450) · 0 = aus": "mV · < value = anaerobic/pathogen risk (RDWC routine 350–450) · 0 = off",
  "Bewässerung — Automatik": "Watering — automatic",
  "Modus": "Mode",
  "Aus (nur manuell)": "Off (manual only)",
  "Intervall": "Interval",
  "Substratfeuchte": "Substrate moisture",
  "Gieß-Dauer": "Watering duration",
  "Sekunden pro Gießvorgang": "seconds per watering cycle",
  "Stunden zwischen Gießvorgängen (Modus Intervall)": "hours between watering cycles (interval mode)",
  "Start unter": "Start below",
  "% Substratfeuchte (Modus Substratfeuchte)": "% substrate moisture (substrate mode)",
  "Mindestpause": "Minimum pause",
  "Minuten zwischen Gießvorgängen (Modus Substratfeuchte)": "minutes between watering cycles (substrate mode)",
  "Nur bei Licht": "Daylight only",
  "nur während der Lichtphase der zugeordneten Kammer gießen": "water only during the light period of the assigned chamber",
  "⚠ Not-Abschaltung": "⚠ Emergency cutoff",
  "Minuten Dauerlauf-Limit (Überflutungsschutz, 0 = aus) — gilt auch für manuelles Gießen": "minutes continuous-run limit (flood protection, 0 = off) — also applies to manual watering",
  "Gegossen wird über die Steckdose mit Rolle „Bewässerung\" (siehe Geräte-Zuordnung, Standard Steckdose 5). Steht die Steckdose auf MANUELL oder hat sie einen Zeitplan, pausiert die Automatik.": "Watering is done via the outlet with role 'Watering' (see device assignment, default outlet 5). If the outlet is set to MANUAL or has a schedule, the automatic pauses.",
  "Zeitpläne — Steckdosen": "Schedules — outlets",
  "Ein (Uhrzeit)": "On (time)",
  "Aus (Uhrzeit)": "Off (time)",
  "Zyklus an (min)": "Cycle on (min)",
  "Zyklus aus (min)": "Cycle off (min)",
  "Tagesplan: täglich Ein/Aus zur Uhrzeit (über Mitternacht erlaubt). Zyklus: x min an / y min aus, Raster ab Mitternacht. Priorität:": "Daily schedule: on/off at fixed times each day (past midnight allowed). Cycle: x min on / y min off, grid from midnight. Priority:",
  "— eine Steckdose mit Zeitplan wird von der Regelung nicht mehr angefasst. Modus „Aus\" gibt sie der Regelung zurück.": "— an outlet with a schedule is no longer touched by the controller. Mode 'Off' returns it to the controller.",
  "Verlauf — Flash-Sicherung": "History — flash backup",
  "Speicher-Intervall": "Save interval",
  "Minuten — sichert 7-Tage-Verlauf + DLI-Tagessumme in den Flash (überlebt Reboot/Update). 0 = aus, Standard 60. Kleinere Werte = mehr Flash-Verschleiß.": "Minutes — saves 7-day history + daily DLI sum to flash (survives reboot/update). 0 = off, default 60. Smaller values = more flash wear.",
  "MQTT-Broker (Home Assistant)": "MQTT broker (Home Assistant)",
  "Broker-URI": "Broker URI",
  "Benutzer": "Username",
  "Passwort": "Password",
  "Sensor-Kalibrierung (Offsets)": "Sensor calibration (offsets)",
  "Sensor": "Sensor",
  "Temp-Offset °C": "Temp offset °C",
  "rH-Offset %": "rH offset %",
  "Additive Korrektur driftender RJ12-Sensoren — wird VOR der VPD-Berechnung angewandt. Bereich ±10 °C / ±20 %. Tipp: gegen ein Referenzthermo-/hygrometer abgleichen.": "Additive correction for drifting RJ12 sensors — applied BEFORE the VPD calculation. Range ±10 °C / ±20 %. Tip: calibrate against a reference thermo/hygrometer.",
  "System & Netzwerk": "System & network",
  "Sprache / Language": "Language",
  "Stellt die Sprache des WebUI um (pro Browser gespeichert).": "Switches the WebUI language (saved per browser).",
  "Deutsch": "German",
  "Hostname (mDNS)": "Hostname (mDNS)",
  "Zeitzone": "Timezone",
  "Mitteleuropa – Berlin/Wien/Zürich (CET/CEST)": "Central Europe – Berlin/Vienna/Zurich (CET/CEST)",
  "Westeuropa – London/Lissabon (GMT/BST)": "Western Europe – London/Lisbon (GMT/BST)",
  "Osteuropa – Athen/Helsinki (EET/EEST)": "Eastern Europe – Athens/Helsinki (EET/EEST)",
  "Moskau (MSK, ohne Sommerzeit)": "Moscow (MSK, no DST)",
  "UTC (ohne Sommerzeit)": "UTC (no DST)",
  "USA Ost – New York (ET)": "US East – New York (ET)",
  "USA West – Los Angeles (PT)": "US West – Los Angeles (PT)",
  "Ortszeit für Licht-/Bewässerungs-/Steckdosen-Zeitpläne. Wirkt sofort, inkl. autom. Sommerzeit": "Local time for light/watering/outlet schedules. Takes effect immediately, incl. auto DST.",
  "Hotspot-Passwort": "Hotspot password",
  "WLAN „iHub\" für Notzugriff ohne Heimnetz — pro Gerät zufällig (nicht mehr universell)": "Wi-Fi 'iHub' for emergency access without home network — random per device (no longer universal)",
  "API-Schutz": "API protection",
  "Sicherheit & Login": "Security & login",
  "Neues Passwort": "New password",
  "leer lassen = unverändert": "leave blank = unchanged",
  "Passwort wiederholen": "Repeat password",
  "Login deaktivieren": "Disable login",
  "Entfernt das Passwort — WebUI wieder ohne Anmeldung erreichbar.": "Removes the password — WebUI accessible again without login.",
  "Login-Status": "Login status",
  "Abmelden": "Log out",
  "API-Token": "API token",
  "Token entfernen": "Remove token",
  "Firmware-Update": "Firmware update",
  "Aktuelle Firmware": "Current firmware",
  "Neue .bin-Datei": "New .bin file",
  "Hochladen & Flashen": "Upload & flash",
  "Neustart": "Reboot",
  "Fortschritt": "Progress",
  "Speichern": "Save",
  "← Zurück zum Dashboard": "← Back to dashboard",
  "Seeds": "Seedling",
  "Stecklinge": "Clones",
  "Wuchs": "Veg",
  "Blüte": "Bloom",
  "Automatics": "Autoflower",
  "Trocknen": "Dry",
  "Aus (Automatik deaktiviert)": "Off (automation disabled)",
  "Kammer A": "Chamber A",
  "Kammer B": "Chamber B",
  "Dachboden": "Attic",
  "Aus": "Off",
  "Tagesplan": "Schedule",
  "Zyklus": "Cycle",
  "Licht 1": "Light 1",
  "Licht 2": "Light 2",
  "Luftbefeuchter": "Humidifier",
  "Entfeuchter": "Dehumidifier",
  "Bewässerung": "Watering",
  "Ventilator": "Fan",
  "Abluft (Inline)": "Exhaust (inline)",
  "Heizung": "Heater",
  "Gerät 1 (CO₂)": "Device 1 (CO₂)",
  "Gerät 2": "Device 2",
  "Sensor-Bus TH3in1": "Sensor-Bus TH3in1",
  "Fan-Bus TH3in1": "Fan-Bus TH3in1",
  "BLE (TP357)": "BLE (TP357)",
  "Grow-Plan aktiv": "Grow plan active",
  "Jetzt starten": "Start now",
  "🌗 Autoflower-Modus": "🌗 Autoflower mode",
  "Licht konstant über alle Phasen (kein 12/12-Umschalten)": "Constant light across all phases (no 12/12 switching)",
  "↳ Licht an / Start": "↳ Light on / start",
  "Tage": "Days",
  "Passwörter stimmen nicht überein": "Passwords do not match",
  "✓ gespeichert": "✓ saved",
  "✓ exportiert": "✓ exported",
  "Keine gültige JSON-Datei": "Not a valid JSON file",
  "Das sieht nicht nach einem iHub-Settings-Export aus.": "This does not look like an iHub settings export.",
  "✓ importiert": "✓ imported",
  "Gerät jetzt neu starten?": "Reboot device now?",
  "Neustart…": "Rebooting…",
  "Bitte zuerst eine .bin-Datei wählen": "Please select a .bin file first",
  "✓ OK — Neustart…": "✓ OK — rebooting…",
  "Verbindung getrennt — evtl. trotzdem geflasht, warte auf Neustart…": "Connection lost — may have flashed anyway, waiting for reboot…",
  "Passwort gesetzt ✓ (Login aktiv)": "Password set ✓ (login active)",
  "kein Passwort — WebUI offen": "no password — WebUI open",
  "•••••• (leer lassen = unverändert)": "•••••• (leave blank = unchanged)",
  "Token gesetzt ✓": "Token set ✓",
  "kein Token": "no token",
  "(wird bei Hotspot-Start erzeugt)": "(generated when hotspot starts)",
  "Passwort gesetzt — bitte neu anmelden.": "Password set — please log in again.",
  "Kammern": "Chambers",
  "Sensoren (global)": "Sensors (global)",
  "⚠ veraltet": "⚠ stale",
  "Quelle: 8-in-1-Tester über Home Assistant. Zielkorridore (RDWC): pH 5,8–6,2 · Wassertemp 18–20 °C · ORP 350–450 mV · EC je Phase. Kachel/Chart anklicken → 7-Tage- bzw. ganzer-Grow-Verlauf.": "Source: 8-in-1 tester via Home Assistant. Target ranges (RDWC): pH 5.8–6.2 · water temp 18–20 °C · ORP 350–450 mV · EC per phase. Click tile/chart → 7-day or full-grow history.",
  "💧 Wasser-Verlauf": "💧 Water history",
  "Verlauf (Live-Sitzung)": "History (live session)",
  "Energie": "Energy",
  "Geräte & Steckdosen": "Devices & outlets",
  "🔔 Alarm-Protokoll": "🔔 Alarm log",
  "🔒 Änderung bestätigen": "🔒 Confirm change",
  "Abbrechen": "Cancel",
  "Ja, ändern": "Yes, change",
  "7 Tage": "7 days",
  "ganzer Grow": "full grow",
  "lädt …": "loading …",
  "Sammle noch Daten … (1 Punkt / 5 min)": "Collecting data … (1 point / 5 min)",
  "Temperatur A/B": "Temperature A/B",
  "Feuchte A/B": "Humidity A/B",
  "VPD A/B": "VPD A/B",
  "Leistung": "Power",
  "Langzeit-Verlauf (7 Tage)": "Long-term history (7 days)",
  "Verlauf (Klick = 7 Tage / ganzer Grow)": "History (click = 7 days / full grow)",
  "Wassertemp": "Water temp",
  "Salinität": "Salinity",
  "Dichte": "Density",
  "Sensor-Bus": "Sensor bus",
  "Fan-Bus": "Fan bus",
  "Temperatur": "Temperature",
  "Feuchte": "Humidity",
  "Abluft": "Exhaust",
  "kein Sensor": "no sensor",
  "viel zu feucht": "way too humid",
  "zu feucht": "too humid",
  "ideal": "ideal",
  "zu trocken": "too dry",
  "viel zu trocken": "way too dry",
  "Start": "Start",
  "Grow starten": "Start grow",
  "Ernte heute! 🎉": "Harvest today! 🎉",
  "letzte Phase": "last phase",
  "Grow-Plan · aktuell": "Grow plan · current",
  "Grow ändern": "Edit grow",
  "ca. Ernte": "est. harvest",
  "Mo": "Mon",
  "Di": "Tue",
  "Mi": "Wed",
  "Do": "Thu",
  "Fr": "Fri",
  "Sa": "Sat",
  "So": "Sun",
  "Grow-Tag": "Grow day",
  "geschätzte Ernte:": "estimated harvest:",
  "AN": "ON",
  "aus": "off",
  "Strom an": "Power on",
  "Strom aus": "Power off",
  "↩ Steckdose auf Automatik": "↩ Outlet to automatic",
  "Einschalten": "Turn on",
  "Ausschalten": "Turn off",
  "Status:": "Status:",
  "Modus:": "Mode:",
  "MANUELL (Override)": "MANUAL (override)",
  "AUTO (Regelung)": "AUTO (control)",
  "Zeitplan:": "Schedule:",
  "Wird von der Klimaregelung gesteuert.": "Controlled by the climate controller.",
  "Auf Automatik zurück": "Back to automatic",
  "Helligkeit (Stufe 0–10)": "Brightness (step 0–10)",
  "Drehzahl": "Speed",
  "↩ Auto (Regelung)": "↩ Auto (control)",
  "Nebelstufe": "Mist level",
  "Auto (VPD)": "Auto (VPD)",
  "0 = aus · 1–4 = Nebelstufe": "0 = off · 1–4 = mist level",
  "↩ Auto (VPD-Regelung)": "↩ Auto (VPD control)",
  "Schwenk": "Oscillation",
  "Spannung": "Voltage",
  "Strom": "Current",
  "Substrat F": "Substrate M",
  "Substrat EC": "Substrate EC",
  "Substrat T": "Substrate T",
  "💧 Bewässerung": "💧 Watering",
  "läuft": "running",
  "Substrat": "Substrate",
  "Drossel": "floor",
  "Dachboden T": "Attic T",
  "Dachboden F": "Attic RH",
  "Klima": "AC",
  "kühlen": "cooling",
  "entfeucht.": "dehumid.",
  "kühl+ent": "cool+dehum",
  "phasenabh.": "phase-dep.",
  "🌡 Temperatur": "🌡 Temperature",
  "💧 Feuchte/Schimmel": "💧 Humidity/mold",
  "⚠ Sensor-Ausfall": "⚠ Sensor failure",
  "💡 Lampe": "💡 Lamp",
  "💧 Wasserwert": "💧 Water value",
  "ausgelöst": "triggered",
  "normalisiert": "normalized",
  "🔕 Quittieren": "🔕 Acknowledge",
  "aktiv": "active",
  "(Free-Cooling reicht nicht)": "(free cooling insufficient)",
  "— Profile, Befeuchter, Abluft & Lichtplan sind wirkungslos!": "— Profiles, humidifier, exhaust & light schedule are inactive!",
  "☀ Tag": "☀ Day",
  "🌙 Nacht": "🌙 Night",
  "⛔ Automatik AUS": "⛔ Automation OFF",
  "⛔ Klima-Automatik AUSGESCHALTET:": "⛔ Climate automation OFF:",
  "Kammer A einschalten": "Enable chamber A",
  "Kammer B einschalten": "Enable chamber B",
  "noch nie gegossen": "never watered",
  "Grow-Start": "Grow start",
  "Manuell": "Manual",
  "Abluft (Lüfter)": "Exhaust (fan)",
  "Lüfter": "Fan"
  };
  function trNode(n){
    var t=n.nodeValue; if(t==null) return;
    var k=t.trim(); if(!k) return;
    var v=EN[k]; if(v!=null && v!==k) n.nodeValue=t.replace(k,v);
  }
  function walk(n){
    if(!n) return;
    if(n.nodeType===3){ trNode(n); return; }
    if(n.nodeType!==1) return;
    var tag=n.tagName;
    if(tag==='SCRIPT'||tag==='STYLE') return;
    if(n.hasAttribute){
      ['placeholder','title'].forEach(function(a){
        if(n.hasAttribute(a)){ var val=n.getAttribute(a),k=val.trim(); if(k){ var e=EN[k]; if(e!=null&&e!==k) n.setAttribute(a,val.replace(k,e)); } }
      });
    }
    for(var c=n.firstChild;c;c=c.nextSibling) walk(c);
  }
  function start(){
    try{ document.documentElement.lang='en'; walk(document.body); }catch(e){}
    try{
      new MutationObserver(function(ms){
        for(var i=0;i<ms.length;i++){
          var m=ms[i];
          if(m.type==='characterData') trNode(m.target);
          else for(var j=0;j<m.addedNodes.length;j++) walk(m.addedNodes[j]);
        }
      }).observe(document.body,{childList:true,subtree:true,characterData:true});
    }catch(e){}
  }
  if(document.readyState==='loading') document.addEventListener('DOMContentLoaded',start);
  else start();
})();
)JS";
